// SPDX-License-Identifier: (GPL-2.0-only OR BSD-2-Clause)

#include "an7581-u-boot.dtsi"
#include "an758x-recovery-layout-u-boot.dtsi"

status_led: &{/leds/led-0} {
};

&recovery_layout {
	factory {
		volume-name = "factory";
		volume-size = <0x240000>;
		volume-type = "dynamic";
		bootph-all;
	};
};

&gdm1 {
	status = "okay";
	bootph-all;
};
